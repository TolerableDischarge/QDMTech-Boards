## mk_01/Firmware/mk_01_zmk/Kconfig.shield
```kconfig
config SHIELD_MK_01_LEFT
    def_bool $(shields_list_contains,mk_01_left)

config SHIELD_MK_01_RIGHT
    def_bool $(shields_list_contains,mk_01_right)
```

## mk_01/v0.1/Firmware/mk_01_zmk/Kconfig.defconfig
```kconfig
if SHIELD_MK_01_LEFT

config ZMK_KEYBOARD_NAME
    default "qdmt mk_01"

config ZMK_SPLIT_BLE_ROLE_CENTRAL
    default y

endif

if SHIELD_MK_01_LEFT || SHIELD_MK_01_RIGHT

config ZMK_SPLIT
    default y

endif
```
